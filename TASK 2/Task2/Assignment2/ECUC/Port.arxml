AUTOSAR XML (schema 4.0)
package /Assignment2
  module config Port
    ecuc param conf container PortConfigSet: destination=AUTOSAR/Assignment2/Port/PortConfigSet
      ecuc param conf container PortContainer_0: destination=AUTOSAR/Assignment2/Port/PortConfigSet/PortContainer/PortContainer_0
        ecuc integer param value PortNumberOfPortPins: value=4
        4 x ecuc param conf container:
          PortPin_0: destination=AUTOSAR/Assignment2/Port/PortConfigSet/PortContainer/PortContainer_0/PortPin/PortPin_0
            ecuc enumeration param value PortPinDirection: value=PORT_PIN_OUT
            ecuc boolean param value PortPinDirectionChangeable: value=0
            ecuc integer param value PortPinId: value=1
            ecuc enumeration param value PortPinInitialMode: value=PORT_PIN_MODE_DIO
            ecuc enumeration param value PortPinLevelValue: value=PORT_PIN_LEVEL_LOW
            ecuc enumeration param value PortPinMode: value=PORT_PIN_MODE_DIO
            ecuc boolean param value PortPinModeChangeable: value=0
            ecuc enumeration param value PortPinInputPullResistor: value=PORT_PIN_IN_NO_PULL
          PortPin_1: destination=AUTOSAR/Assignment2/Port/PortConfigSet/PortContainer/PortContainer_0/PortPin/PortPin_1
            ecuc enumeration param value PortPinDirection: value=PORT_PIN_IN
            ecuc boolean param value PortPinDirectionChangeable: value=0
            ecuc integer param value PortPinId: value=2
            ecuc enumeration param value PortPinInitialMode: value=PORT_PIN_MODE_DIO
            ecuc enumeration param value PortPinLevelValue: value=PORT_PIN_LEVEL_HIGH
            ecuc enumeration param value PortPinMode: value=PORT_PIN_MODE_DIO
            ecuc boolean param value PortPinModeChangeable: value=0
            ecuc enumeration param value PortPinInputPullResistor: value=PORT_PIN_IN_PULL_DOWN
          PortPin_2: destination=AUTOSAR/Assignment2/Port/PortConfigSet/PortContainer/PortContainer_0/PortPin/PortPin_2
            ecuc enumeration param value PortPinDirection: value=PORT_PIN_IN
            ecuc boolean param value PortPinDirectionChangeable: value=0
            ecuc integer param value PortPinId: value=3
            ecuc enumeration param value PortPinInitialMode: value=PORT_PIN_MODE_DIO
            ecuc enumeration param value PortPinLevelValue: value=PORT_PIN_LEVEL_HIGH
            ecuc enumeration param value PortPinMode: value=PORT_PIN_MODE_DIO
            ecuc boolean param value PortPinModeChangeable: value=0
            ecuc enumeration param value PortPinInputPullResistor: value=PORT_PIN_IN_PULL_UP
          PortPin_3: destination=AUTOSAR/Assignment2/Port/PortConfigSet/PortContainer/PortContainer_0/PortPin/PortPin_3
            ecuc enumeration param value PortPinDirection: value=PORT_PIN_IN
            ecuc boolean param value PortPinDirectionChangeable: value=0
            ecuc integer param value PortPinId: value=4
            ecuc enumeration param value PortPinInitialMode: value=PORT_PIN_MODE_DIO
            ecuc enumeration param value PortPinLevelValue: value=PORT_PIN_LEVEL_HIGH
            ecuc enumeration param value PortPinMode: value=PORT_PIN_MODE_DIO
            ecuc boolean param value PortPinModeChangeable: value=0
            ecuc enumeration param value PortPinInputPullResistor: value=PORT_PIN_IN_NO_PULL
    ecuc param conf container PortGeneral: destination=AUTOSAR/Assignment2/Port/PortGeneral
      4 x ecuc boolean param value:
        PortDevErrorDetect: value=0
        PortSetPinDirectionApi: value=1
        PortSetPinModeApi: value=0
        PortVersionInfoApi: value=0
