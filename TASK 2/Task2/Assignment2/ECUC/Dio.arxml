AUTOSAR XML (schema 4.0)
package /Assignment2
  module config Dio
    ecuc param conf container DioConfig: destination=AUTOSAR/Assignment2/Dio/DioConfig
      ecuc param conf container DioPort_0: destination=AUTOSAR/Assignment2/Dio/DioConfig/DioPort/DioPort_0
        ecuc integer param value DioPortId: value=1
        5 x ecuc param conf container:
          DioChannel_0: destination=AUTOSAR/Assignment2/Dio/DioConfig/DioPort/DioPort_0/DioChannel/DioChannel_0
            ecuc integer param value DioChannelId: value=0
          DioChannel_1: destination=AUTOSAR/Assignment2/Dio/DioConfig/DioPort/DioPort_0/DioChannel/DioChannel_1
            ecuc integer param value DioChannelId: value=1
          DioChannel_2: destination=AUTOSAR/Assignment2/Dio/DioConfig/DioPort/DioPort_0/DioChannel/DioChannel_2
            ecuc integer param value DioChannelId: value=2
          DioChannel_3: destination=AUTOSAR/Assignment2/Dio/DioConfig/DioPort/DioPort_0/DioChannel/DioChannel_3
            ecuc integer param value DioChannelId: value=3
          DioChannelGroup_0: destination=AUTOSAR/Assignment2/Dio/DioConfig/DioPort/DioPort_0/DioChannelGroup/DioChannelGroup_0
            ecuc string param value DioChannelGroupIdentification: value=PORTC
            ecuc integer param value DioPortMask: value=1
            ecuc integer param value DioPortOffset: value=1
    ecuc param conf container DioGeneral: destination=AUTOSAR/Assignment2/Dio/DioGeneral
      ecuc boolean param value DioDevErrorDetect: value=0
      ecuc boolean param value DioFlipChannelApi: value=0
      ecuc boolean param value DioVersionInfoApi: value=0
