AUTOSAR XML (schema 00046)
package /TopLevelComposition_package
  composition sw component type TopLevelComposition
    component DigOutParam_Inst1: type=DigOutParam_Inst
    component IOHwAbSDigOut_Inst1: type=IoHwAbsDigOut_Inst
    component TestAppSWC1: type=TestAppSWC
    connect DigOutParam_Inst1.ChEnable -> IOHwAbSDigOut_Inst1.ChEnable
    connect DigOutParam_Inst1.IsHighPolarity -> IOHwAbSDigOut_Inst1.IsHighPolarity
    connect IOHwAbSDigOut_Inst1.SetOutputStatus -> TestAppSWC1.SetOutpStatus_Inst1
