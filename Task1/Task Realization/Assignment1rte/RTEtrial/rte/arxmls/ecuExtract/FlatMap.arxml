AUTOSAR XML (schema 00046)
package /FlatMap_package
  flat map FlatMap
    flat instance descriptor DigOutParam_Inst1: upstream-reference=RootSwCompositionPrototype_0.DigOutParam_Inst1, ecu-extract-reference=EcuInstance_0_FlatView.DigOutParam_Inst1
    flat instance descriptor IOHwAbSDigOut_Inst1: upstream-reference=RootSwCompositionPrototype_0.IOHwAbSDigOut_Inst1, ecu-extract-reference=EcuInstance_0_FlatView.IOHwAbSDigOut_Inst1
    flat instance descriptor TestAppSWC1: upstream-reference=RootSwCompositionPrototype_0.TestAppSWC1, ecu-extract-reference=EcuInstance_0_FlatView.TestAppSWC1
