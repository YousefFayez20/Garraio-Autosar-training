AUTOSAR XML (schema 00046)
package /TopLevelComposition_package
  composition sw component type TopLevelComposition
    component DigOutParam_Inst1: type=DigOutParam_Inst
    component IOHwAbSDigOut_Inst1: type=IoHwAbsDigOut_Inst
    component TestAppSWC1: type=TestAppSWC
