AUTOSAR XML (schema 00046)
package /Interfaces
  client server interface CsIf_DigOut
    operation CsIf_DigOut_SetSt
      arg CsIf_DigOut_SetSt_Argument_1: type=DioLevel, direction=IN
    error E_OK: error-code=0
    error E_NOT_OK: error-code=1
  parameter interface ParmIf_ChEnable
    parameter data prototype ChEnable_Parm: sw-calibration-access=READ-ONLY, type=Interface_BOOLEAN
  parameter interface ParmIf_ChCalibration
    parameter data prototype IsHighPoarity_parm: sw-calibration-access=READ-ONLY, type=Interface_BOOLEAN
