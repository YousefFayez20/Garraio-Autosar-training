AUTOSAR XML (schema 00046)
standard types defined: sint8, sint16, sint32, sint64, uint8, uint16, uint32, uint64, sint8_least, sint16_least, sint32_least, uint8_least, uint16_least, uint32_least, boolean, float32, float64
package /AUTOSAR_PlatformTypes/VALUE
  impl type DioLevel: category=VALUE, base-type=uint8
  impl type Interface_BOOLEAN: category=VALUE, base-type=boolean
